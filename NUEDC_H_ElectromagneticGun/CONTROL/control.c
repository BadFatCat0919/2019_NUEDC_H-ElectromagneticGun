///////////////////////////////////////////////////////////////////-=505-Tech=-///
//电赛H题-模拟电磁曲射炮-控制算法
///////////////////////////////////////////////////////////////////-=505-Tech=-///
//版本：V3.0
//编写：徐天泽
//中国民航大学电子科技创新创业实践基地505创客实验室
///////////////////////////////////////////////////////////////////-=505-Tech=-///
//本程序仅供学习参考，未经许可，不得用于其它任何用途
///////////////////////////////////////////////////////////////////-=505-Tech=-///
#include "control.h"
#include "PID.h"
///////////////////////////////////////////////////////////////////-=505-Tech=-///
void Limiting(int* Value,int Range);
void Set_PWM(int pwm);
int Read_Encoder(void);
///////////////////////////////////////////////////////////////////-=505-Tech=-///
/********************************************************************************
    功能：	TIM6定时中断服务函数
    参数：	无
    返回：	无
    备注：	包含所有控制算法，10ms运行一次，使用前请确保TIM6已初始化
*********************************************************************************/
void TIM6_IRQHandler(void)
{
	if(TIM_GetITStatus(TIM6, TIM_IT_Update) != RESET)     //检查TIM6更新中断发生与否
	{
		TIM_ClearITPendingBit(TIM6, TIM_IT_Update);         //清除TIM6更新中断标志
    ////////////////////////////在这里编写你的代码/////////////////////////////
    LED2_Flash(100);
    ///////////////////////////////////END///////////////////////////////////
		
	}
}
/********************************************************************************
    功能：	TIM7定时中断服务函数
    参数：	无
    返回：	无
    备注：	100ms运行一次，使用前请确保TIM7已初始化
*********************************************************************************/
void TIM7_IRQHandler(void)
{
	if(TIM_GetITStatus(TIM7, TIM_IT_Update) != RESET)     //检查TIM7更新中断发生与否
	{
		TIM_ClearITPendingBit(TIM7, TIM_IT_Update);         //清除TIM6更新中断标志
    ////////////////////////////在这里编写你的代码/////////////////////////////
		
    ///////////////////////////////////END///////////////////////////////////
		
	}
}
/********************************************************************************
    功能：	限幅
    参数：
            Value       需要限幅的变量地址
            Range	      限制幅度
    返回：	无
    备注：	内部函数
*********************************************************************************/
void Limiting(int* Value,int Range)
{
    if(*Value >  Range)*Value =  Range;
    if(*Value < -Range)*Value = -Range;
}/********************************************************************************
    功能：	更新PWM到电机上
    参数： pwm   PWM值
    返回：	无
    备注：	内部函数
*********************************************************************************/
void Set_PWM(int pwm)
{

}
/********************************************************************************
    功能：	读编码器值
    参数： 无
    返回：	无
    备注：	内部函数
*********************************************************************************/
int Read_Encoder(void)
{
return 0;
}
///////////////////////////////////////////////////////////////////-=505-Tech=-///
